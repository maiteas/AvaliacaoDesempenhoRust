# file: mutex.ioc
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FREERTOS.Mutexes01=myMutexSaida1,Dynamic,NULL;myMutexSaida2,Dynamic,NULL;myMutexSaida3,Dynamic,NULL;myMutexSaida4,Dynamic,NULL;myMutexLED5,Dynamic,NULL
FREERTOS.Tasks01=defaultTask,0,128,StartDefaultTask,Default,NULL,Dynamic,NULL,NULL;myTaskTarefa_um,-3,128,Tarefa_um,Default,NULL,Dynamic,NULL,NULL;myTaskTarefa_do,-3,128,Tarefa_dois,Default,NULL,Dynamic,NULL,NULL;myTaskTarefa_tr,-3,128,Tarefa_tres,Default,NULL,Dynamic,NULL,NULL;myTaskTarefa_qu,-3,128,Tarefa_quatro,Default,NULL,Dynamic,NULL,NULL
Mcu.Family=STM32G0
Mcu.Name=STM32G070RBTx
Mcu.Package=LQFP64
ProjectManager.HeapSize=0x200
ProjectManager.StackSize=0x400
ProjectManager.TargetToolchain=STM32CubeIDE
RCC.AHBFreq_Value=16000000
RCC.CortexFreq_Value=16000000
RCC.EXTERNAL_CLOCK_VALUE=48000
RCC.HCLKFreq_Value=16000000
RCC.HSE_VALUE=8000000
RCC.HSI_VALUE=16000000
RCC.LSE_VALUE=32768
RCC.SYSCLKFreq_VALUE=16000000
RCC.VCOOutputFreq_Value=128000000
VP_FREERTOS_VS_CMSIS_V1.Mode=CMSIS_V1
VP_SYS_VS_DBSignals.Mode=DisableDeadBatterySignals
board=custom

// file: Core/Src/main.c
/* USER CODE BEGIN Header */
/**
  ******************************************************************************
  * @file           : main.c
  * @brief          : Main program body
  ******************************************************************************
  * @attention
  *
  * Copyright (c) 2024 STMicroelectronics.
  * All rights reserved.
  *
  * This software is licensed under terms that can be found in the LICENSE file
  * in the root directory of this software component.
  * If no LICENSE file comes with this software, it is provided AS-IS.
  *
  ******************************************************************************
  */
/* USER CODE END Header */
#include "main.h"
#include "cmsis_os.h"

/* USER CODE BEGIN PM */
//#define LED1_PIN       (1 << 0)
#define LED1_PIN       (1 << 1)
#define LED2_PIN       (1 << 2)
#define LED3_PIN       (1 << 3)
#define LED4_PIN       (1 << 4)

/* USER CODE END PM */

osThreadId defaultTaskHandle;
osThreadId myTaskTarefa_umHandle;
osThreadId myTaskTarefa_doHandle;
osThreadId myTaskTarefa_trHandle;
osThreadId myTaskTarefa_quHandle;
osMutexId myMutexSaida1Handle;
osMutexId myMutexSaida2Handle;
osMutexId myMutexSaida3Handle;
osMutexId myMutexSaida4Handle;
osMutexId myMutexLED5Handle;

void SystemClock_Config(void);
void StartDefaultTask(void const * argument);
void Tarefa_um(void const * argument);
void Tarefa_dois(void const * argument);
void Tarefa_tres(void const * argument);
void Tarefa_quatro(void const * argument);

/* USER CODE BEGIN PFP */
/* Função para configurar o GPIOA */
void GPIO_Config(void) {
    // Habilita o clock do GPIO A
    RCC->IOPENR |= RCC_IOPENR_GPIOAEN;

    // Configura PA0-PA4 como saída
    GPIOA->MODER &= ~(0x3 << (0 * 2));  // Limpa os bits de modo para PA0
    GPIOA->MODER |= (0x1 << (0 * 2));   // Configura PA0 como saída

    GPIOA->MODER &= ~(0x3 << (1 * 2));  // Limpa os bits de modo para PA1
    GPIOA->MODER |= (0x1 << (1 * 2));   // Configura PA1 como saída

    GPIOA->MODER &= ~(0x3 << (2 * 2));  // Limpa os bits de modo para PA2
    GPIOA->MODER |= (0x1 << (2 * 2));   // Configura PA2 como saída

    GPIOA->MODER &= ~(0x3 << (3 * 2));  // Limpa os bits de modo para PA3
    GPIOA->MODER |= (0x1 << (3 * 2));   // Configura PA3 como saída

    GPIOA->MODER &= ~(0x3 << (4 * 2));  // Limpa os bits de modo para PA4
    GPIOA->MODER |= (0x1 << (4 * 2));   // Configura PA4 como saída
}

/* USER CODE END PFP */

int main(void)
{

  /* MCU Configuration--------------------------------------------------------*/

  /* Reset of all peripherals, Initializes the Flash interface and the Systick. */
 // HAL_Init();

  /* USER CODE BEGIN Init */
	 GPIO_Config();

  /* USER CODE END Init */

  /* Configure the system clock */
 // SystemClock_Config();

  /* Initialize all configured peripherals */

  /* Create the mutex(es) */
  /* definition and creation of myMutexSaida1 */
  osMutexDef(myMutexSaida1);
  myMutexSaida1Handle = osMutexCreate(osMutex(myMutexSaida1));

  /* definition and creation of myMutexSaida2 */
  osMutexDef(myMutexSaida2);
  myMutexSaida2Handle = osMutexCreate(osMutex(myMutexSaida2));

  /* definition and creation of myMutexSaida3 */
  osMutexDef(myMutexSaida3);
  myMutexSaida3Handle = osMutexCreate(osMutex(myMutexSaida3));

  /* definition and creation of myMutexSaida4 */
  osMutexDef(myMutexSaida4);
  myMutexSaida4Handle = osMutexCreate(osMutex(myMutexSaida4));

  /* Create the thread(s) */
  /* definition and creation of defaultTask */

  /* definition and creation of myTaskTarefa_um */
  osThreadDef(myTaskTarefa_um, Tarefa_um, osPriorityIdle, 0, 128);
  myTaskTarefa_umHandle = osThreadCreate(osThread(myTaskTarefa_um), NULL);

  /* definition and creation of myTaskTarefa_do */
  osThreadDef(myTaskTarefa_do, Tarefa_dois, osPriorityIdle, 0, 128);
  myTaskTarefa_doHandle = osThreadCreate(osThread(myTaskTarefa_do), NULL);

  /* definition and creation of myTaskTarefa_tr */
  osThreadDef(myTaskTarefa_tr, Tarefa_tres, osPriorityIdle, 0, 128);
  myTaskTarefa_trHandle = osThreadCreate(osThread(myTaskTarefa_tr), NULL);

  /* definition and creation of myTaskTarefa_qu */
  osThreadDef(myTaskTarefa_qu, Tarefa_quatro, osPriorityIdle, 0, 128);
  myTaskTarefa_quHandle = osThreadCreate(osThread(myTaskTarefa_qu), NULL);

  /* Start scheduler */
  osKernelStart();

  /* We should never get here as control is now taken by the scheduler */

  /* Infinite loop */
  while (1)
  {

  }
}

void Tarefa_um(void const * argument)
{
  /* USER CODE BEGIN Tarefa_um */
  /* Infinite loop */
  for(;;)
  {
	  if (osMutexWait(myMutexSaida1Handle, osWaitForever) == osOK) {
	      GPIOA->ODR |= LED1_PIN;
	      GPIOA->ODR &= ~LED2_PIN;
	      GPIOA->ODR &= ~LED3_PIN;
	      GPIOA->ODR &= ~LED4_PIN;
	      osMutexRelease(myMutexSaida1Handle);
	   }
    osDelay(1200);
  }
  /* USER CODE END Tarefa_um */
}

void Tarefa_dois(void const * argument)
{
  /* USER CODE BEGIN Tarefa_dois */
  /* Infinite loop */
  for(;;)
  {
	  if (osMutexWait(myMutexSaida2Handle, osWaitForever) == osOK) {
		             // Apagar todos os LEDs
		          //  GPIOA->ODR &= ~(LED1_PIN | LED3_PIN | LED4_PIN );
		             // Acender LED2
		             GPIOA->ODR |= LED2_PIN;
		             GPIOA->ODR &= ~LED1_PIN;
		         	 GPIOA->ODR &= ~LED3_PIN;
		         	 GPIOA->ODR &= ~LED4_PIN;
		             osMutexRelease(myMutexSaida2Handle);
		         }
	    osDelay(1800);
  }
  /* USER CODE END Tarefa_dois */
}

void Tarefa_tres(void const * argument)
{
  /* USER CODE BEGIN Tarefa_tres */
  /* Infinite loop */
  for(;;)
  {

	    if (osMutexWait(myMutexSaida3Handle, osWaitForever) == osOK) {
	            // Apagar todos os LEDs
	        //    GPIOA->ODR &= ~(LED1_PIN | LED2_PIN | LED4_PIN );
	            // Acender LED3
	            GPIOA->ODR |= LED3_PIN;
	            GPIOA->ODR &= ~LED1_PIN;
	        	GPIOA->ODR &= ~LED2_PIN;
	        	GPIOA->ODR &= ~LED4_PIN;
	            osMutexRelease(myMutexSaida3Handle);
	        }
	        osDelay(2500); // Delay para controlar a frequência
  }
  /* USER CODE END Tarefa_tres */
}

void Tarefa_quatro(void const * argument)
{
  /* USER CODE BEGIN Tarefa_quatro */
  /* Infinite loop */
  for(;;)
  {
	    if (osMutexWait(myMutexSaida4Handle, osWaitForever) == osOK) {
	            // Apagar todos os LEDs
	           // GPIOA->ODR &= ~(LED1_PIN | LED2_PIN | LED3_PIN );
	            // Acender LED4
	            GPIOA->ODR |= LED4_PIN;
	            GPIOA->ODR &= ~LED1_PIN;
	        	GPIOA->ODR &= ~LED2_PIN;
	        	GPIOA->ODR &= ~LED3_PIN;
	            osMutexRelease(myMutexSaida4Handle);
	        }
  osDelay(3900);

  }
  /* USER CODE END Tarefa_quatro */
}

void Error_Handler(void)
{
  __disable_irq();
  while (1)
  {
  }
}
