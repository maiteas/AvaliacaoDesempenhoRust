# file: canal_2.ioc
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FREERTOS.Queues01=myQueueFila1,16,uint16_t,0,Dynamic,NULL,NULL;myQueueFila2,16,uint16_t,0,Dynamic,NULL,NULL;myQueueFila3,16,uint16_t,0,Dynamic,NULL,NULL
FREERTOS.Tasks01=myTaskTarefa_um,0,128,Tarefa_um,Default,NULL,Dynamic,NULL,NULL;myTaskTarefa_do,-3,128,Tarefa_dois,Default,NULL,Dynamic,NULL,NULL;myTaskTarefa_tr,-3,128,Tarefa_tres,Default,NULL,Dynamic,NULL,NULL
Mcu.Family=STM32G0
Mcu.Name=STM32G070RBTx
Mcu.Package=LQFP64
ProjectManager.HeapSize=0x200
ProjectManager.StackSize=0x400
ProjectManager.TargetToolchain=STM32CubeIDE
RCC.AHBFreq_Value=16000000
RCC.CortexFreq_Value=16000000
RCC.EXTERNAL_CLOCK_VALUE=48000
RCC.HCLKFreq_Value=16000000
RCC.HSE_VALUE=8000000
RCC.HSI_VALUE=16000000
RCC.LSE_VALUE=32768
RCC.SYSCLKFreq_VALUE=16000000
RCC.VCOOutputFreq_Value=128000000
VP_FREERTOS_VS_CMSIS_V1.Mode=CMSIS_V1
VP_SYS_VS_DBSignals.Mode=DisableDeadBatterySignals
board=custom

// file: Core/Src/main.c
/* USER CODE BEGIN Header */
/**
  ******************************************************************************
  * @file           : main.c
  * @brief          : Main program body
  ******************************************************************************
  * @attention
  *
  * Copyright (c) 2024 STMicroelectronics.
  * All rights reserved.
  *
  * This software is licensed under terms that can be found in the LICENSE file
  * in the root directory of this software component.
  * If no LICENSE file comes with this software, it is provided AS-IS.
  *
  ******************************************************************************
  */
/* USER CODE END Header */
#include "main.h"
#include "cmsis_os.h"

/* USER CODE BEGIN Includes */
#include "stm32g0xx.h"
/* USER CODE END Includes */

/* USER CODE BEGIN PD */

#define LED1_PIN       (1 << 1)
#define LED2_PIN       (1 << 2)
#define LED3_PIN       (1 << 3)
#define LED4_PIN       (1 << 4)

/* USER CODE END PD */

osThreadId myTaskTarefa_umHandle;
osThreadId myTaskTarefa_doHandle;
osThreadId myTaskTarefa_trHandle;
osMessageQId myQueueFila1Handle;
osMessageQId myQueueFila2Handle;
osMessageQId myQueueFila3Handle;

void SystemClock_Config(void);
void Tarefa_um(void const * argument);
void Tarefa_dois(void const * argument);
void Tarefa_tres(void const * argument);

/* USER CODE BEGIN 0 */
void GPIO_Config(void) {
    // Habilita o clock do GPIO A
    RCC->IOPENR |= RCC_IOPENR_GPIOAEN;

    GPIOA->MODER &= ~(0x3 << (1 * 2));  // Limpa os bits de modo para PA1
    GPIOA->MODER |= (0x1 << (1 * 2));   // Configura PA1 como saída

    GPIOA->MODER &= ~(0x3 << (2 * 2));  // Limpa os bits de modo para PA2
    GPIOA->MODER |= (0x1 << (2 * 2));   // Configura PA2 como saída

    GPIOA->MODER &= ~(0x3 << (3 * 2));  // Limpa os bits de modo para PA3
    GPIOA->MODER |= (0x1 << (3 * 2));   // Configura PA3 como saída

}

/* USER CODE END 0 */

int main(void)
{

  /* MCU Configuration--------------------------------------------------------*/

  /* Reset of all peripherals, Initializes the Flash interface and the Systick. */
 // HAL_Init();

  /* Configure the system clock */
 // SystemClock_Config();

  /* Initialize all configured peripherals */
  /* USER CODE BEGIN 2 */
	GPIO_Config();

  /* USER CODE END 2 */

  /* Create the queue(s) */
  /* definition and creation of myQueueFila1 */
  osMessageQDef(myQueueFila1, 2, uint16_t);
  myQueueFila1Handle = osMessageCreate(osMessageQ(myQueueFila1), NULL);

  /* definition and creation of myQueueFila2 */
  osMessageQDef(myQueueFila2, 2, uint16_t);
  myQueueFila2Handle = osMessageCreate(osMessageQ(myQueueFila2), NULL);

  /* definition and creation of myQueueFila3 */
  osMessageQDef(myQueueFila3, 2, uint16_t);
  myQueueFila3Handle = osMessageCreate(osMessageQ(myQueueFila3), NULL);

  /* Create the thread(s) */
  /* definition and creation of myTaskTarefa_um */
  osThreadDef(myTaskTarefa_um, Tarefa_um, osPriorityNormal, 0, 128);
  myTaskTarefa_umHandle = osThreadCreate(osThread(myTaskTarefa_um), NULL);

  /* definition and creation of myTaskTarefa_do */
  osThreadDef(myTaskTarefa_do, Tarefa_dois, osPriorityIdle, 0, 128);
  myTaskTarefa_doHandle = osThreadCreate(osThread(myTaskTarefa_do), NULL);

  /* definition and creation of myTaskTarefa_tr */
  osThreadDef(myTaskTarefa_tr, Tarefa_tres, osPriorityIdle, 0, 128);
  myTaskTarefa_trHandle = osThreadCreate(osThread(myTaskTarefa_tr), NULL);

  /* Start scheduler */
  osKernelStart();

  /* We should never get here as control is now taken by the scheduler */

  /* Infinite loop */
  while (1)
  {

  }
}

void Tarefa_um(void const * argument)
{
  /* USER CODE BEGIN 5 */
  /* Infinite loop */
	int value =0;
  for(;;)
  {
	  value = (value == 1) ? 0 : 1;
		  if(value == 0){
			  GPIOA->ODR |= LED1_PIN;
		  }else{
			  GPIOA->ODR &= ~LED1_PIN;
		  }

		  osMessagePut(myQueueFila1Handle, value, osWaitForever);
	    osDelay(900);

  }
  /* USER CODE END 5 */
}

void Tarefa_dois(void const * argument)
{
  /* USER CODE BEGIN Tarefa_dois */
	/*infinite loop*/
	   osEvent event;
	for(;;)
	{
	  event = osMessageGet(myQueueFila1Handle, osWaitForever);
	 	  if (event.status == osEventMessage) {
	 	    int valueR = event.value.v;
	 	    if (valueR == 0) {

	 	    GPIOA->ODR |= LED2_PIN;

	 	    } else {
	 	    GPIOA->ODR &= ~LED2_PIN;

	 	    }
	 	    osMessagePut(myQueueFila2Handle, valueR, osWaitForever);
	 	    }
	     osDelay(1000);
}
  /* USER CODE END Tarefa_dois */
}

void Tarefa_tres(void const * argument)
{
  /* USER CODE BEGIN Tarefa_tres */
  /* Infinite loop */
	  for(;;)
	  {
		  osEvent event; // Estrutura para armazenar o evento recebido

		  	  for(;;)
		  	  {
		  		  event = osMessageGet(myQueueFila2Handle, osWaitForever);
		  		  if (event.status == osEventMessage) {
		  		    int valueR = event.value.v;
		  		    if (valueR == 0) {

		  		    GPIOA->ODR |= LED3_PIN;

		  		    } else {
		  		    GPIOA->ODR &= ~LED3_PIN;

		  		    }
		  		    }
		  	    osDelay(1300);
		  	  }
	  }
  /* USER CODE END Tarefa_tres */
}

void Error_Handler(void)
{
  __disable_irq();
  while (1)
  {
  }
}
