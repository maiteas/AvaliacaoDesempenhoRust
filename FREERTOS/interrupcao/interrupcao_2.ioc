# file: interrupcao_2.ioc
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FREERTOS.Tasks01=myTaskTarefa_um,0,128,Tarefa_um,Default,NULL,Dynamic,NULL,NULL;myTaskTarefa_sa,0,128,Tarefa_saida,Default,NULL,Dynamic,NULL,NULL
Mcu.Family=STM32G0
Mcu.Name=STM32G070RBTx
Mcu.Package=LQFP64
ProjectManager.HeapSize=0x200
ProjectManager.StackSize=0x400
ProjectManager.TargetToolchain=STM32CubeIDE
RCC.AHBFreq_Value=16000000
RCC.CortexFreq_Value=16000000
RCC.EXTERNAL_CLOCK_VALUE=48000
RCC.HCLKFreq_Value=16000000
RCC.HSE_VALUE=8000000
RCC.HSI_VALUE=16000000
RCC.LSE_VALUE=32768
RCC.SYSCLKFreq_VALUE=16000000
RCC.VCOOutputFreq_Value=128000000
VP_FREERTOS_VS_CMSIS_V1.Mode=CMSIS_V1
VP_SYS_VS_DBSignals.Mode=DisableDeadBatterySignals
board=custom

// file: Core/Src/main.c
/* USER CODE BEGIN Header */
/**
  ******************************************************************************
  * @file           : main.c
  * @brief          : Main program body
  ******************************************************************************
  * @attention
  *
  * Copyright (c) 2024 STMicroelectronics.
  * All rights reserved.
  *
  * This software is licensed under terms that can be found in the LICENSE file
  * in the root directory of this software component.
  * If no LICENSE file comes with this software, it is provided AS-IS.
  *
  ******************************************************************************
  */
/* USER CODE END Header */
#include "main.h"
#include "cmsis_os.h"

/* USER CODE BEGIN Includes */
#include "stm32g0xx.h"
#include <stdbool.h>  // Biblioteca para usar o tipo bool
#include <stdatomic.h>
/* USER CODE END Includes */

/* USER CODE BEGIN PD */

#define LED2_PIN       (1 << 1)
#define LED1_PIN       (1 << 2)

atomic_bool SAIDA_STATE;
/* USER CODE END PD */

osThreadId myTaskTarefa_umHandle;
osThreadId myTaskTarefa_saHandle;

void SystemClock_Config(void);
void Tarefa_um(void const * argument);
void Tarefa_saida(void const * argument);

/* USER CODE BEGIN PFP */

void EXTI4_15_IRQHandler(void){

	if(EXTI->FPR1 & EXTI_FPR1_FPIF9){
	EXTI->FPR1 |= EXTI_FPR1_FPIF9;

		bool current_state = atomic_load(&SAIDA_STATE);
		atomic_store(&SAIDA_STATE, !current_state);
		}

}

/* USER CODE END PFP */

/* USER CODE BEGIN 0 */
void GPIO_Config(void) {
    // Habilita o clock do GPIO A
    RCC->IOPENR |= RCC_IOPENR_GPIOAEN;
    RCC->IOPENR |= RCC_IOPENR_GPIOBEN;

    GPIOA->MODER &= ~(0x3 << (1 * 2));  // Limpa os bits de modo para PA1
    GPIOA->MODER |= (0x1 << (1 * 2));   // Configura PA1 como saída

    GPIOA->MODER &= ~(0x3 << (2 * 2));  // Limpa os bits de modo para PA2
    GPIOA->MODER |= (0x1 << (2 * 2));   // Configura PA2 como saída

    /********** PB9 set for EXTI ************/
    /*set Input (0b00)*/
    GPIOB->MODER &= ~(GPIO_MODER_MODE9_0 | GPIO_MODER_MODE9_1);
    /*set low speed (0b01)*/
    GPIOB->OSPEEDR |= GPIO_OSPEEDR_OSPEED9_0 ;
    GPIOB->OSPEEDR &= ~GPIO_OSPEEDR_OSPEED9_1 ;
    /*set Pull-up (0b01)*/
    GPIOB->PUPDR |= GPIO_PUPDR_PUPD9_0 ;
    GPIOB->PUPDR &= ~GPIO_PUPDR_PUPD9_1;
    /*set EXTI for PB9 - 9(EXTI9) PB(0b01)*/
    EXTI->EXTICR[2] &= ~EXTI_EXTICR3_EXTI9 ; //clear
    EXTI->EXTICR[2] |=  EXTI_EXTICR3_EXTI9_0 ; //set 0b01
    /*set EXTI Falling triger for Line no. 9 (PB9)*/
    EXTI->FTSR1 |= EXTI_FTSR1_FT9 ;
    /*set EXTI Interrupt no-masked for Line no.9 (PB9)*/
    EXTI->IMR1 |= EXTI_IMR1_IM9 ;

         // 4. Habilitar a interrupção no NVIC
    NVIC_SetPriority(EXTI4_15_IRQn, 0);
    NVIC_EnableIRQ(EXTI4_15_IRQn);

}

/* USER CODE END 0 */

int main(void)
{

  /* MCU Configuration--------------------------------------------------------*/

  /* Reset of all peripherals, Initializes the Flash interface and the Systick. */
//  HAL_Init();

  /* USER CODE BEGIN Init */
	  GPIO_Config();

  /* USER CODE END Init */

  /* Configure the system clock */
  //SystemClock_Config();

  /* Initialize all configured peripherals */

  /* Create the thread(s) */
  /* definition and creation of myTaskTarefa_um */
  osThreadDef(myTaskTarefa_um, Tarefa_um, osPriorityNormal, 0, 128);
  myTaskTarefa_umHandle = osThreadCreate(osThread(myTaskTarefa_um), NULL);

  /* definition and creation of myTaskTarefa_sa */
  osThreadDef(myTaskTarefa_sa, Tarefa_saida, osPriorityNormal, 0, 128);
  myTaskTarefa_saHandle = osThreadCreate(osThread(myTaskTarefa_sa), NULL);

  /* Start scheduler */
  osKernelStart();

  /* We should never get here as control is now taken by the scheduler */

  /* Infinite loop */
  while (1)
  {

  }
}

void Tarefa_um(void const * argument)
{
  /* USER CODE BEGIN 5 */
  /* Infinite loop */
	  for(;;)
	  {
		  GPIOA->ODR ^= LED2_PIN; // Toggle the LED state

	    osDelay(500);
	  }
  /* USER CODE END 5 */
}

void Tarefa_saida(void const * argument)
{
  /* USER CODE BEGIN Tarefa_saida */
  /* Infinite loop */
	atomic_store(&SAIDA_STATE, false); // Inicializa o estado como OFF
  for(;;)
  {
      if (atomic_load(&SAIDA_STATE)) {
    	  GPIOA->ODR |= LED1_PIN;
		 } else {
			 GPIOA->ODR &= ~LED1_PIN;

		 }
		 osDelay(500);  // Atualiza a cada 1 segundo
  }
  /* USER CODE END Tarefa_saida */
}

void Error_Handler(void)
{
  __disable_irq();
  while (1)
  {
  }
}
